## buildroot-external/configs/rpi4_defconfig
```kconfig
BR2_aarch64=y
BR2_cortex_a72=y
BR2_ARM_FPU_VFPV4=y
BR2_DL_DIR="$(TOPDIR)/../download"
BR2_KERNEL_MIRROR="https://www.kernel.org/pub"
BR2_GNU_MIRROR="http://ftp.gnu.org/pub/gnu"
BR2_CCACHE=y
BR2_OPTIMIZE_2=y
BR2_GLOBAL_PATCH_DIR="$(BR2_EXTERNAL_THINROOT_PATH)/patches"
BR2_RELRO_PARTIAL=y
BR2_TOOLCHAIN_BUILDROOT_GLIBC=y
BR2_PACKAGE_HOST_LINUX_HEADERS_CUSTOM_5_10=y
BR2_TOOLCHAIN_BUILDROOT_CXX=y
BR2_GCC_ENABLE_LTO=y
BR2_TARGET_GENERIC_HOSTNAME="thinroot"
BR2_TARGET_GENERIC_ISSUE="Welcome to thinRoot"
BR2_TARGET_GENERIC_PASSWD_SHA512=y
BR2_ROOTFS_DEVICE_CREATION_DYNAMIC_EUDEV=y
BR2_TARGET_GENERIC_GETTY_PORT="tty2"
BR2_ENABLE_LOCALE_WHITELIST="C en_US de_DE"
BR2_GENERATE_LOCALE="en_US de_DE"
BR2_SYSTEM_ENABLE_NLS=y
BR2_TARGET_TZ_INFO=y
BR2_TARGET_LOCALTIME="Europe/Berlin"
BR2_ROOTFS_USERS_TABLES="${BR2_EXTERNAL_THINROOT_PATH}/board/rpi4/users_table.txt"
BR2_ROOTFS_OVERLAY="$(BR2_EXTERNAL_THINROOT_PATH)/rootfs-overlay"
BR2_ROOTFS_POST_BUILD_SCRIPT="$(BR2_EXTERNAL_THINROOT_PATH)/board/rpi4/post-build.sh"
BR2_ROOTFS_POST_IMAGE_SCRIPT="$(BR2_EXTERNAL_THINROOT_PATH)/board/rpi4/post-image.sh"
BR2_ROOTFS_POST_SCRIPT_ARGS="$(BR2_EXTERNAL_THINROOT_PATH)/board/rpi4"
BR2_LINUX_KERNEL=y
BR2_LINUX_KERNEL_CUSTOM_TARBALL=y
BR2_LINUX_KERNEL_CUSTOM_TARBALL_LOCATION="https://github.com/raspberrypi/linux/archive/raspberrypi-kernel_1.20210527-1.tar.gz"
BR2_LINUX_KERNEL_PATCH="$(BR2_EXTERNAL_THINROOT_PATH)/board/rpi4/kernel-patches"
BR2_LINUX_KERNEL_USE_CUSTOM_CONFIG=y
BR2_LINUX_KERNEL_CUSTOM_CONFIG_FILE="$(BR2_EXTERNAL_THINROOT_PATH)/board/rpi4/kernel_defconfig"
BR2_LINUX_KERNEL_LZ4=y
BR2_LINUX_KERNEL_DTS_SUPPORT=y
BR2_LINUX_KERNEL_INTREE_DTS_NAME="broadcom/bcm2711-rpi-4-b broadcom/bcm2711-rpi-400 broadcom/bcm2711-rpi-cm4"
BR2_LINUX_KERNEL_NEEDS_HOST_OPENSSL=y
BR2_PACKAGE_BUSYBOX_CONFIG="$(BR2_EXTERNAL_THINROOT_PATH)/Busybox.config"
BR2_PACKAGE_BUSYBOX_SHOW_OTHERS=y
BR2_PACKAGE_ALSA_UTILS=y
BR2_PACKAGE_ALSA_UTILS_AMIXER=y
BR2_PACKAGE_GSTREAMER1=y
BR2_PACKAGE_GST1_PLUGINS_BASE_PLUGIN_VIDEOCONVERT=y
BR2_PACKAGE_GST1_PLUGINS_BASE_PLUGIN_ALSA=y
BR2_PACKAGE_GST1_PLUGINS_GOOD=y
BR2_PACKAGE_GST1_PLUGINS_GOOD_PLUGIN_MATROSKA=y
BR2_PACKAGE_GST1_PLUGINS_GOOD_PLUGIN_RTSP=y
BR2_PACKAGE_GST1_PLUGINS_GOOD_PLUGIN_VPX=y
BR2_PACKAGE_GST1_PLUGINS_BAD=y
BR2_PACKAGE_GST1_PLUGINS_BAD_PLUGIN_MPEGTSDEMUX=y
BR2_PACKAGE_GST1_LIBAV=y
BR2_PACKAGE_PULSEAUDIO=y
BR2_PACKAGE_DOSFSTOOLS=y
BR2_PACKAGE_DOSFSTOOLS_FATLABEL=y
BR2_PACKAGE_DOSFSTOOLS_FSCK_FAT=y
BR2_PACKAGE_E2FSPROGS=y
BR2_PACKAGE_EXFAT=y
BR2_PACKAGE_F2FS_TOOLS=y
BR2_PACKAGE_NTFS_3G=y
BR2_PACKAGE_DEJAVU=y
BR2_PACKAGE_LIBERATION=y
BR2_PACKAGE_FREERDP=y
BR2_PACKAGE_MESA3D=y
BR2_PACKAGE_MESA3D_GALLIUM_DRIVER_KMSRO=y
BR2_PACKAGE_MESA3D_GALLIUM_DRIVER_SWRAST=y
BR2_PACKAGE_MESA3D_GALLIUM_DRIVER_V3D=y
BR2_PACKAGE_MESA3D_GALLIUM_DRIVER_VC4=y
BR2_PACKAGE_MESA3D_OPENGL_ES=y
BR2_PACKAGE_PSPLASH=y
BR2_PACKAGE_PSPLASH_PATCH="$(BR2_EXTERNAL_THINROOT_PATH)/patches/psplash/hzdr"
BR2_PACKAGE_QT5BASE_OPENGL=y
BR2_PACKAGE_QT5BASE_LINUXFB=y
BR2_PACKAGE_QT5BASE_DEFAULT_QPA="xcb"
BR2_PACKAGE_XORG7=y
BR2_PACKAGE_XSERVER_XORG_SERVER=y
BR2_PACKAGE_XLIB_LIBXSCRNSAVER=y
BR2_PACKAGE_XLIB_LIBXAW=y
BR2_PACKAGE_XAPP_XPROP=y
BR2_PACKAGE_XAPP_XRANDR=y
BR2_PACKAGE_XAPP_XSETROOT=y
BR2_PACKAGE_XDRIVER_XF86_INPUT_EVDEV=y
BR2_PACKAGE_XDRIVER_XF86_INPUT_KEYBOARD=y
BR2_PACKAGE_XDRIVER_XF86_INPUT_MOUSE=y
BR2_PACKAGE_XDRIVER_XF86_VIDEO_FBDEV=y
BR2_PACKAGE_XDRIVER_XF86_VIDEO_FBTURBO=y
BR2_PACKAGE_XFONT_FONT_MISC_CYRILLIC=y
BR2_PACKAGE_NODM=y
BR2_PACKAGE_QT_WEBKIT_KIOSK=y
BR2_PACKAGE_QT_WEBKIT_KIOSK_SOUNDS=y
BR2_PACKAGE_XDOTOOL=y
BR2_PACKAGE_OPENBOX=y
BR2_PACKAGE_LINUX_FIRMWARE=y
BR2_PACKAGE_RPI_BT_FIRMWARE=y
BR2_PACKAGE_RPI_FIRMWARE=y
BR2_PACKAGE_RPI_FIRMWARE_VERSION="1.20210527"
BR2_PACKAGE_RPI_FIRMWARE_VARIANT_PI4=y
BR2_PACKAGE_RPI_WIFI_FIRMWARE=y
BR2_PACKAGE_ACPID=y
BR2_PACKAGE_DBUS=y
BR2_PACKAGE_EUDEV_RULES_GEN=y
BR2_PACKAGE_I2C_TOOLS=y
BR2_PACKAGE_RNG_TOOLS=y
BR2_PACKAGE_RPI_USERLAND=y
BR2_PACKAGE_UBOOT_TOOLS=y
BR2_PACKAGE_UBOOT_TOOLS_MKIMAGE=y
BR2_PACKAGE_UBOOT_TOOLS_MKENVIMAGE=y
BR2_PACKAGE_UBOOT_TOOLS_DUMPIMAGE=y
BR2_PACKAGE_USBMOUNT=y
BR2_PACKAGE_CA_CERTIFICATES=y
BR2_PACKAGE_LIBGCRYPT=y
BR2_PACKAGE_CAIRO_PNG=y
BR2_PACKAGE_JPEG=y
BR2_PACKAGE_OPENJPEG=y
BR2_PACKAGE_WAYLAND=y
BR2_PACKAGE_WEBP=y
BR2_PACKAGE_WEBP_DEMUX=y
BR2_PACKAGE_LIBXSLT=y
BR2_PACKAGE_LIBSOUP=y
BR2_PACKAGE_LIBTASN1=y
BR2_PACKAGE_READLINE=y
BR2_PACKAGE_CHRONY=y
BR2_PACKAGE_DHCPCD=y
BR2_PACKAGE_DROPBEAR=y
BR2_PACKAGE_DROPBEAR_DISABLE_REVERSEDNS=y
BR2_PACKAGE_NTP=y
# BR2_PACKAGE_NTP_NTPD is not set
BR2_PACKAGE_NTP_NTPDATE=y
BR2_PACKAGE_WGET=y
BR2_PACKAGE_IRQBALANCE=y
BR2_PACKAGE_TAR=y
BR2_PACKAGE_UTIL_LINUX_RFKILL=y
BR2_TARGET_ROOTFS_CPIO=y
BR2_TARGET_ROOTFS_CPIO_LZ4=y
BR2_TARGET_ROOTFS_CPIO_UIMAGE=y
# BR2_TARGET_ROOTFS_TAR is not set
BR2_TARGET_UBOOT=y
BR2_TARGET_UBOOT_BUILD_SYSTEM_KCONFIG=y
BR2_TARGET_UBOOT_CUSTOM_VERSION=y
BR2_TARGET_UBOOT_CUSTOM_VERSION_VALUE="2021.04"
BR2_TARGET_UBOOT_PATCH="$(BR2_EXTERNAL_THINROOT_PATH)/board/rpi4/uboot-patches"
BR2_TARGET_UBOOT_USE_CUSTOM_CONFIG=y
BR2_TARGET_UBOOT_CUSTOM_CONFIG_FILE="$(BR2_EXTERNAL_THINROOT_PATH)/board/rpi4/uboot_defconfig"
BR2_TARGET_UBOOT_NEEDS_DTC=y
BR2_PACKAGE_HOST_DOSFSTOOLS=y
BR2_PACKAGE_HOST_E2FSPROGS=y
BR2_PACKAGE_HOST_GENIMAGE=y
BR2_PACKAGE_HOST_MKPASSWD=y
BR2_PACKAGE_HOST_MTOOLS=y
BR2_PACKAGE_HOST_UBOOT_TOOLS_BOOT_SCRIPT=y
BR2_PACKAGE_HOST_UBOOT_TOOLS_BOOT_SCRIPT_SOURCE="$(BR2_EXTERNAL_THINROOT_PATH)/board/rpi4/boot.cmd"
BR2_PACKAGE_QUTSELECT=y
BR2_PACKAGE_HOTKEYD=y
BR2_PACKAGE_NUMLOCKX=y
BR2_PACKAGE_XPRINTIDLE=y
BR2_PACKAGE_RPI_EEPROM=y
```

## buildroot-external/package/hotkeyd/Config.in
```kconfig
config BR2_PACKAGE_HOTKEYD
	bool "hotkeyd"
	help
	  Uber-small hotkey daemon for GNU/Linux

	  https://github.com/vflyson/hotkeyd
```

## buildroot-external/package/numlockx/Config.in
```kconfig
config BR2_PACKAGE_NUMLOCKX
	bool "numlockx"
	help
	  This little thingy allows you to start X with NumLock turned on

	  https://github.com/rg3/numlockx
```

## buildroot-external/package/phodav/Config.in
```kconfig
config BR2_PACKAGE_PHODAV
	bool "phodav"
	select BR2_PACKAGE_LIBSOUP3
	help
	  minimal WebDAV server implementation using GNOME libsoup (RFC 4918)

	  https://gitlab.gnome.org/GNOME/phodav
```

## buildroot-external/package/qt-kiosk-browser/Config.in
```kconfig
config BR2_PACKAGE_QT_KIOSK_BROWSER
	bool "qt-kiosk-browser"
	select BR2_PACKAGE_QT5WEBENGINE
	select BR2_PACKAGE_QT5VIRTUALKEYBOARD
	help
	  Simple Qt-based kiosk browser
```

## buildroot-external/package/qt-webengine-kiosk/Config.in
```kconfig
config BR2_PACKAGE_QT_WEBENGINE_KIOSK
	bool "qt-webengine-kiosk"
	select BR2_PACKAGE_QT5WEBENGINE
	select BR2_PACKAGE_QT5MULTIMEDIA
	help
	  Simple Qt Webengine browser
```

## buildroot-external/package/qutselect/Config.in
```kconfig
config BR2_PACKAGE_QUTSELECT
	bool "qutselect"
	select BR2_PACKAGE_QT6
	select BR2_PACKAGE_QT6BASE
	select BR2_PACKAGE_QT6BASE_GUI
	select BR2_PACKAGE_QT6BASE_XCB
	select BR2_PACKAGE_QT6X11EXTRAS
	select BR2_PACKAGE_QT6BASE_FONTCONFIG
	select BR2_PACKAGE_QT6BASE_PNG
	select BR2_PACKAGE_QT6BASE_WIDGETS
	select BR2_PACKAGE_QT6BASE_NETWORK
	select BR2_PACKAGE_JQ
	select BR2_PACKAGE_LIBCURL
	select BR2_PACKAGE_LIBCURL_CURL
	select BR2_PACKAGE_YAD
	help
	  A Qt-based (unix) terminal server selection tool

	  https://github.com/hzdr/qutselect
```

## buildroot-external/package/remmina/Config.in
```kconfig
config BR2_PACKAGE_REMMINA
	bool "remmina"
	select BR2_PACKAGE_CAIRO_ZLIB
#	select BR2_PACKAGE_AVAHI
	select BR2_PACKAGE_LIBGTK3
	select BR2_PACKAGE_LIBVNCSERVER
	select BR2_PACKAGE_LIBSODIUM
	select BR2_PACKAGE_JSON_GLIB
	select BR2_PACKAGE_LIBSOUP
	select BR2_PACKAGE_LIBRSVG
	select BR2_PACKAGE_HICOLOR_ICON_THEME
	select BR2_PACKAGE_ADWAITA_ICON_THEME
	select BR2_PACKAGE_SHARED_MIME_INFO
	help
	  Remmina is a remote desktop client written in GTK+, aiming
	  to be useful for system administrators and travellers, who
	  need to work with lots of remote computers in front of either
	  large monitors or tiny netbooks.

	  Remmina supports multiple network protocols in an integrated
	  and consistent user interface.

	  Currently RDP, VNC, NX, XDMCP and SSH are supported.

	  https://gitlab.com/Remmina/Remmina
```

## buildroot-external/package/setrootpix/Config.in
```kconfig
config BR2_PACKAGE_SETROOTPIX
	bool "setrootpix"
	select BR2_PACKAGE_XLIB_LIBX11
	help
	  A utility to set the X11 root window to dedicated color in
	  a compositor-compatible way.
```

## buildroot-external/package/spice-gtk/Config.in
```kconfig
config BR2_PACKAGE_SPICE_GTK
	bool "spice-gtk"
	select BR2_PACKAGE_SPICE_PROTOCOL
	select BR2_PACKAGE_HOST_PYTHON_SIX
	select BR2_PACKAGE_HOST_PYTHON_PYPARSING
	select BR2_PACKAGE_JPEG
	select BR2_PACKAGE_LIBJPEG
	select BR2_PACKAGE_JSON_GLIB
	select BR2_PACKAGE_GSTREAMER1
	select BR2_PACKAGE_GST1_PLUGINS_BASE
	select BR2_PACKAGE_GST1_PLUGINS_BASE_PLUGIN_OPUS
	select BR2_PACKAGE_GST1_PLUGINS_BASE_PLUGIN_APP
	select BR2_PACKAGE_GST1_PLUGINS_GOOD
	select BR2_PACKAGE_GST1_PLUGINS_GOOD_PLUGIN_PULSE
	select BR2_PACKAGE_GST1_PLUGINS_GOOD_PLUGIN_AUTODETECT
	select BR2_PACKAGE_GST1_PLUGINS_BAD
	select BR2_PACKAGE_GST1_PLUGINS_BAD_PLUGIN_OPUS
	select BR2_PACKAGE_LIBUSB
	select BR2_PACKAGE_USBREDIR
	select BR2_PACKAGE_USBUTILS
	select BR2_PACKAGE_LZ4
	select BR2_PACKAGE_PHODAV
	select BR2_PACKAGE_OPUS
	help
	  SPICE Client library using GLib and GTK+

	  https://gitlab.freedesktop.org/spice/spice-gtk
```

## buildroot-external/package/thinlinc-nightly/Config.in
```kconfig
config BR2_PACKAGE_THINLINC_NIGHTLY
	bool "thinlinc-nightly"
	help
	  A X11 Remote Desktop client (Nightly Build)

	  https://www.cendio.com/thinlinc
```

## buildroot-external/package/thinlinc/Config.in
```kconfig
config BR2_PACKAGE_THINLINC
	bool "thinlinc"
	help
	  A X11 Remote Desktop client

	  https://www.cendio.com/thinlinc
```

## buildroot-external/package/virt-viewer/Config.in
```kconfig
config BR2_PACKAGE_VIRT_VIEWER
	bool "virt-viewer"
	select BR2_PACKAGE_CAIRO_ZLIB
	select BR2_PACKAGE_LIBGTK3
	select BR2_PACKAGE_SPICE_GTK
	help
	  The virtual machine console viewer

	  https://gitlab.com/virt-viewer/virt-viewer
```

## buildroot-external/package/xfce-minimal/Config.in
```kconfig
menu "Xfce minimal (xfwm4 only)"

comment "Xfce minimal (xfwm4 only) needs X11 + GTK3 + D-Bus"
	depends on !BR2_PACKAGE_XORG7
	depends on !BR2_PACKAGE_LIBGTK3
	depends on !BR2_PACKAGE_DBUS

config BR2_PACKAGE_LIBXFCE4UTIL
	bool "libxfce4util"
	depends on BR2_PACKAGE_XORG7
	depends on BR2_PACKAGE_LIBGLIB2
	help
	  Basic utility library used by multiple Xfce components.
	  Required by xfconf and libxfce4ui.

config BR2_PACKAGE_XFCONF
	bool "xfconf"
	depends on BR2_PACKAGE_DBUS
	depends on BR2_PACKAGE_LIBXFCE4UTIL
	help
	  Xfce configuration system (D-Bus daemon + xfconf-query).
	  xfwm4 uses xfconf as its primary configuration backend.

config BR2_PACKAGE_LIBXFCE4UI
	bool "libxfce4ui"
	depends on BR2_PACKAGE_LIBGTK3
	depends on BR2_PACKAGE_XFCONF
	help
	  Common GTK3 widgets used by Xfce components (and xfwm4).

config BR2_PACKAGE_LIBWNCK
	bool "libwnck"
	depends on BR2_PACKAGE_LIBGTK3
	depends on BR2_PACKAGE_XORG7
	depends on BR2_PACKAGE_XLIB_LIBXRES
	help
	  GNOME Window Navigator Construction Kit (GTK3).
	  xfwm4 uses it for window/task handling helpers.

config BR2_PACKAGE_XFWM4
	bool "xfwm4 (Xfce Window Manager)"
	depends on BR2_PACKAGE_LIBGTK3
	depends on BR2_PACKAGE_XORG7
	depends on BR2_PACKAGE_XFCONF
	depends on BR2_PACKAGE_LIBWNCK
	select BR2_PACKAGE_LIBX11
	select BR2_PACKAGE_LIBXEXT
	select BR2_PACKAGE_LIBXRENDER
	select BR2_PACKAGE_LIBXRANDR
	select BR2_PACKAGE_LIBXCOMPOSITE
	select BR2_PACKAGE_LIBXDAMAGE
	select BR2_PACKAGE_LIBXFIXES
	help
	  Xfce window manager, usable standalone in a plain X11 session.
	  Configuration is stored via xfconf (typically under
	  $XDG_CONFIG_HOME/xfce4/xfconf/xfce-perchannel-xml/xfwm4.xml).

if BR2_PACKAGE_XFWM4

config BR2_PACKAGE_XFWM4_COMPOSITOR
	bool "enable xfwm4 compositor"
	default n
	help
	  If disabled, xfwm4 is built without its built-in compositor, saving
	  some code/CPU. Keep disabled for a thin client unless you explicitly
	  need compositing (shadows/transparency).

endif

endmenu
```

## buildroot-external/package/xkb-switch/Config.in
```kconfig
config BR2_PACKAGE_XKB_SWITCH
	bool "xkb-switch"
	depends on BR2_PACKAGE_XORG7
	select BR2_PACKAGE_XLIB_LIBX11
	select BR2_PACKAGE_XLIB_LIBXKBFILE
	help
	  CLI zum Abfragen/Umschalten des XKB-Layouts.
```

## buildroot-external/package/xosd/Config.in
```kconfig
config BR2_PACKAGE_XOSD
	bool "xosd"
	help
	  XOSD

	  https://sourceforge.net/projects/libxosd/
```

## buildroot-external/package/xprintidle/Config.in
```kconfig
config BR2_PACKAGE_XPRINTIDLE
	bool "xprintidle"
	help
	  a utility that queries the X server for the user's idle time and prints it to stdout

	  https://github.com/g0hl1n/xprintidle
```

## buildroot-external/package/yoe-kiosk-browser/Config.in
```kconfig
config BR2_PACKAGE_YOE_KIOSK_BROWSER
	bool "yoe-kiosk-browser"
	select BR2_PACKAGE_HOST_QT6TOOLS
	select BR2_PACKAGE_QT6WEBENGINE
	select BR2_PACKAGE_QT6MULTIMEDIA
	select BR2_PACKAGE_QT6DECLARATIVE
	select BR2_PACKAGE_QT6DECLARATIVE_QUICK
	select BR2_PACKAGE_QT6SHADERTOOLS
	select BR2_PACKAGE_QT6VIRTUALKEYBOARD
	help
	  Simple Qt Webengine browser
```
